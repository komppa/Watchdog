## CMakeLists.txt
```
cmake_minimum_required(VERSION 3.8.2)

find_package(Zephyr REQUIRED HINTS $ENV{ZEPHYR_BASE})
project(watchdog)

target_sources(app PRIVATE src/main.c)
zephyr_library_sources(src/http_request.h)
zephyr_library_sources(src/http_request.c)

zephyr_library_sources(src/wsensor.h)
zephyr_library_sources(src/wsensor.c)

zephyr_library_sources(src/at_cmd.h)
zephyr_library_sources(src/at_cmd.c)

zephyr_library_sources(src/led.h)
zephyr_library_sources(src/led.c)

zephyr_library_sources(src/movement.h)
zephyr_library_sources(src/movement.c)

zephyr_library_sources(src/settings.h)
zephyr_library_sources(src/settings.c)

zephyr_library_sources(src/btn_handler.h)
zephyr_library_sources(src/btn_handler.c)


zephyr_library_sources(src/payloads.h)
zephyr_library_sources(src/payloads.c)

zephyr_library_sources(src/supl_support.h)
zephyr_library_sources(src/supl_support.c)


target_link_libraries(app PUBLIC libm.a)
```

## prj.conf
```kconfig
CONFIG_LTE_AUTO_INIT_AND_CONNECT=n

# PSM
CONFIG_LTE_PSM_REQ_RPTAU="00000110"
CONFIG_LTE_PSM_REQ_RAT="00000000"	

CONFIG_PRINTK=y

CONFIG_BSD_LIBRARY=y
CONFIG_BSD_LIBRARY_SYS_INIT=y

CONFIG_NETWORKING=y
CONFIG_NET_BUF_USER_DATA_SIZE=1
CONFIG_NET_SOCKETS_OFFLOAD=y
CONFIG_NET_SOCKETS=y
CONFIG_NET_NATIVE=n ## on or off !
CONFIG_NET_SOCKETS_POSIX_NAMES=y
CONFIG_TRUSTED_EXECUTION_NONSECURE=y
CONFIG_NET_SOCKETS_SOCKOPT_TLS=y

# HEAP AND STACKS
CONFIG_HEAP_MEM_POOL_SIZE=4096
CONFIG_MAIN_STACK_SIZE=4096
CONFIG_SYSTEM_WORKQUEUE_STACK_SIZE=2048
CONFIG_MAIN_THREAD_PRIORITY=7

# t suosituksia
CONFIG_NRF9160_GPS_HANDLE_MODEM_CONFIGURATION=y
CONFIG_MODEM_KEY_MGMT=y
CONFIG_LTE_LINK_CONTROL=y
 # OTIN ASKEN POIS

CONFIG_LTE_NETWORK_MODE_LTE_M_GPS=y
#JOTTA LTE JA GPS

CONFIG_AT_CMD_PARSER=y
CONFIG_AT_CMD=y
CONFIG_AT_CMD_RESPONSE_MAX_LEN=2560
CONFIG_AT_NOTIF=y
 
CONFIG_SERIAL=y # here
CONFIG_UART_INTERRUPT_DRIVEN=y
CONFIG_TEST_RANDOM_GENERATOR=y
 
# FOR CJSON
CONFIG_NEWLIB_LIBC=y
CONFIG_CJSON_LIB=y

# FOR TEMPERATURE SENSOR
#CONFIG_STDOUT_CONSOLE=y
#CONFIG_I2C=y
#CONFIG_SENSOR=y
#CONFIG_BME680=y
# ucomment all there 4 up !

CONFIG_AT_CMD_LOG_LEVEL_DBG=y

CONFIG_GPIO=y

# FOR ACCELEROMETER
CONFIG_SPI=y

#CONFIG_SENSOR=y #ALREADY IN TEMP
#CONFIG_ADXL362=y
#CONFIG_ADXL362_TRIGGER_GLOBAL_THREAD=y
#CONFIG_ADXL362_INTERRUPT_MODE=1
#CONFIG_ADXL362_ABS_REF_MODE=1
# UNCOMMENT ALL THESE BOT NO CONFIG_SENSOR Y !

CONFIG_NEWLIB_LIBC_FLOAT_PRINTF=y

# GPS
CONFIG_NRF9160_GPS=y
CONFIG_NRF9160_GPS_LOG_LEVEL_DBG=y

# SUPL 
CONFIG_SUPL_CLIENT_LIB=y

# LOG 
CONFIG_LOG=y
```

## src/main.c
```c
#include <string.h>
#include <zephyr.h>
#include <stdlib.h>
#include <device.h>
#include <drivers/gpio.h>
#include <sys/util.h>
#include <inttypes.h>
#include "led.h"
#include "movement.h"
#include "payloads.h"
#include "settings.h"
#include "http_request.h"
#include "wsensor.h"
#include "at_cmd.h"
#include "btn_handler.h"

// GPS
#include <nrf_socket.h>
#include <net/socket.h>
#include <stdio.h>
#include <string.h>
#include <drivers/gps.h>
#include <math.h>

// Network init
#include <modem/lte_lc.h>

#ifdef CONFIG_SUPL_CLIENT_LIB
#include <supl_os_client.h>
#include <supl_session.h>
#include "supl_support.h"
#endif

#define GNSS_INIT_AND_START 1
#define GNSS_STOP           2
#define GNSS_RESTART        3

#define GPS_DEVICE "NRF9160_GPS"

#define IMEI_LENGHT 15
#define SENSOR_RETRY_TIMES 2
#define REGISTRATION_RETRY_TIMES 3
#define STATUS_RETRY_TIMES 3
#define ALERT_RETRY_TIMES 9
#define SPACE 32
#define QUOTE 34
#define REQ_RETRIES 5

#define FLAGS_OR_ZERO(node) \
    COND_CODE_1(DT_PHA_HAS_CELL(node, gpios, flags),    \
    (DT_GPIO_FLAGS(node, gpios)),   \
    (0))

#define SW0_NODE	DT_ALIAS(sw0)

#if DT_NODE_HAS_STATUS(SW0_NODE, okay)
#define SW0_GPIO_LABEL	DT_GPIO_LABEL(SW0_NODE, gpios)
#define SW0_GPIO_PIN	DT_GPIO_PIN(SW0_NODE, gpios)
#define SW0_GPIO_FLAGS	(GPIO_INPUT | FLAGS_OR_ZERO(SW0_NODE))
#else
#error "Unsupported board: sw0 devicetree alias is not defined"
#define SW0_GPIO_LABEL	""
#define SW0_GPIO_PIN	0
#define SW0_GPIO_FLAGS	0
#endif

static void send_sensor(void);
static void request_registration(void);
static void trigger_alert(void);
static void system_status(void);
static void send_location(void);

LOG_MODULE_REGISTER(main, LOG_LEVEL_DBG);

static struct gpio_callback button_cb_data;

/* 
    For http requests, req_response contains whole response 
    (header + message) and req_res_content only msg
*/
char req_response[2048];
char req_res_content[2048];

struct device *gps_dev;

void gps_event_handler(struct device *dev, struct gps_event *evt)
{
	int err;

	if (evt->type == GPS_EVT_PVT_FIX)
	{
        set_location(evt->pvt.latitude, evt->pvt.longitude);
        // When location sent to the server, reset gps_searching flag
        set_gps_searching(false);
        set_send_gps_location(true);
	}
	
	if (evt->type == GPS_EVT_AGPS_DATA_NEEDED) {
		err = open_supl_socket();
		if (err == 0) {
			printk("SUPL socket opened succesfully\n");
		} else {
			printk("Opening SUPL socket failed! Err: %d\n", err);
		}
		int status = supl_session(&evt->agps_request);
	}

    if (evt->type == GPS_EVT_SEARCH_TIMEOUT) {
        set_location(0, 0); // Zeros means no fix
        set_gps_searching(false);
        set_send_gps_location(true);
    }
}

#ifdef CONFIG_SUPL_CLIENT_LIB
int inject_agps_type(void *agps, size_t agps_size, nrf_gnss_agps_data_type_t type, void *user_data)
{
	
	ARG_UNUSED(user_data);
	int retval = 0;
	
	// Mapping data types
	switch (type) {
		case NRF_GNSS_AGPS_UTC_PARAMETERS:
			type = GPS_AGPS_UTC_PARAMETERS;
			break;
		case NRF_GNSS_AGPS_EPHEMERIDES:
			type = GPS_AGPS_EPHEMERIDES;
			break;
		case NRF_GNSS_AGPS_ALMANAC:
			type = GPS_AGPS_ALMANAC;
			break;
		case NRF_GNSS_AGPS_KLOBUCHAR_IONOSPHERIC_CORRECTION:
			type = GPS_AGPS_KLOBUCHAR_CORRECTION ;
			break;
		case NRF_GNSS_AGPS_NEQUICK_IONOSPHERIC_CORRECTION:
			type = GPS_AGPS_NEQUICK_CORRECTION ;
			break;
		case NRF_GNSS_AGPS_GPS_SYSTEM_CLOCK_AND_TOWS:
			type = GPS_AGPS_GPS_SYSTEM_CLOCK_AND_TOWS;
			break;
		case NRF_GNSS_AGPS_LOCATION:
			type = GPS_AGPS_LOCATION;
			break;
		case NRF_GNSS_AGPS_INTEGRITY:
			type = GPS_AGPS_INTEGRITY;
			break;
		default:
			return -1;
	}
	
	retval = gps_agps_write(
				gps_dev,	// dev Pointer to GPS device
				type,		// type A-GPS data type
				agps,		// data Pointer to A-GPS data
				sizeof(agps)
	);

	if (retval != 0) {
		printk("Failed to send AGNSS data, type: %d (err: %d)\n",
		       type,
		       errno);
		return -1;
	}

	printk("Injected AGPS data, flags: %d, size: %d\n", type, agps_size);

	return 0;
}
#endif

/* Check button's state when button has been pressed or released */
void button_pressed(struct device *dev, struct gpio_callback *cb, u32_t pins)
{
    u32_t btn_high = 0; // Timestamp when button pressed
    
    int pin_status = gpio_pin_read(dev, SW0_GPIO_PIN, &btn_high);
    if (pin_status != 0) printk("There is something wrong with the gpio_pin_read function :(");
    if (btn_high == 1) {
        setBtnDownTime();
    } else {
        setBtnUpTime();
        set_btn_act_pending(true); // Flag for button
    }
}

/* Send sensor data to the server */
void send_sensor(void)
{    
    send_request(req_response, SENSOR_DATA);
    parse_response(req_response);
}

/* Send registration request to the server */
void request_registration(void)
{
    send_request(req_response, REGISTRATION_DATA);
    parse_response(req_response);
}

/* Trigger alert */
void trigger_alert(void)
{
    send_request(req_response, ALERT_DATA);
    parse_response(req_response);
}

/* Change system's current armed status and send it to the server */
void system_status(void)
{
    // Change system status opposite
    toggle_system_armed();
    send_request(req_response, ARM_DATA);
    parse_response(req_response);
    if (!get_system_armed()) {
        for (int x = 0; x < 3; x++) {
            slowFlashLed(1);
        }
    } else {
        calibrate_movement();
    }   
}

/* Send location to the server */
void send_location()
{
    send_request(req_response, LOCATION_DATA);
    parse_response(req_response);
}

void main(void)
{
   	int err;	
	bool first_time = true; // Sensor data won't be trasmitted on start up right away
    struct device *button;
	int ret;
    
    /* Inits */
    
    // SUPL init before GPS start
    static struct supl_api supl_api = {
        .read       = supl_read,	// supl_support
        .write      = supl_write,	// supl_support
        .handler    = inject_agps_type,	// this file
        .logger     = supl_logger,	// supl_support
        .counter_ms = k_uptime_get
    };
		
	// GPS start
	struct gps_config conf = {
		.nav_mode = GPS_NAV_MODE_SINGLE_FIX ,
		.power_mode = GPS_POWER_MODE_DISABLED,
		.interval = 0,
		.timeout = 120,  // FOR DEV PURPOSES - CHANGE TO 360
		.delete_agps_data = false
	};	
   
    // Enabling PSM
    lte_lc_psm_req(true); 
	
    
    // Connect Thingy to the network
    /*
	printk("Waiting for network..\n");	
	err = lte_lc_init_and_connect();
	if (err) {
        if (err == -120) {
            printk("Device has established connection already to network. \n");
        } else {
            printk("Failed to connect to the LTE network, err %d\n", err);
            return;
        }
		
	}
    
	printk("Connected to the network! \n");
    */

    init_led();
    //init_movement();
    //init_bme680();
    init_http_request();
    // Get device's IMEI on startup that it can be accessible using get_imei()
    get_device_imei();  
    /* System var inits */
    set_system_armed(false);    // On default, system status will be disarmed
    set_alert_interval(30);  // Interval how often alert can trigger
    set_alert_pending(false);
    
    // Thingy:91's onboard button
    button = device_get_binding(SW0_GPIO_LABEL);
	if (button == NULL) {
		printk("Error: didn't find %s device\n", SW0_GPIO_LABEL);
	}

	ret = gpio_pin_configure(button, SW0_GPIO_PIN, SW0_GPIO_FLAGS);
	if (ret != 0) {
		printk("Error %d: failed to configure %s pin %d\n",
		       ret, SW0_GPIO_LABEL, SW0_GPIO_PIN);
	}

	ret = gpio_pin_interrupt_configure(button, SW0_GPIO_PIN, GPIO_INT_EDGE_BOTH);
	if (ret != 0) {
		printk("Error %d: failed to configure interrupt on %s pin %d\n",
			ret, SW0_GPIO_LABEL, SW0_GPIO_PIN);
	}

    // Assign callbacks for onboard button
	gpio_init_callback(&button_cb_data, button_pressed, BIT(SW0_GPIO_PIN));
	gpio_add_callback(button, &button_cb_data);


    // GPS
    gps_dev = device_get_binding(GPS_DEVICE);
	if (gps_dev == NULL) {
		printk("Could not get %s device\n", GPS_DEVICE);
		return;
	}

	printk("Initting SUPL ! \n");
	int rc = supl_init(&supl_api);	// function from supl_os_clie   nt.h
	if (rc != 0) {
		return;
	} else {
		printk("SUPL INIT returned %d ! \n", rc);
	}
	    
	printk("Initting GPS ! \n");
	err = gps_init(gps_dev, gps_event_handler);
	if (err) {
		printk("Err with gps_init\n");
	} else {
		printk("Initialized GPS succesfully ! \n");
	}

    // Send sensor data immediately when Thginy has started

    send_sensor();

    // If system's status is disarmed at startup, show green light to the user
    if (!get_system_armed()) {
        for (int x = 0; x < 3; x++) {
            slowFlashLed(1);
        }
    }
    

    while (1)
    {

        // Button action pending
        if (get_btn_act_pending()  && !get_http_request_executing()) 
        {
            // Handle button only if GPS is not active
            if (!get_gps_searching()) {
                printk("GPS not active - handling button presss\n");
                set_btn_act_pending(false);
                switch (calcBtnTime()) {
                    case 1: 
                        // Short press -> show battery charge
                        switch (get_battery_level())
                        {
                            case 0:
                                slowFlashLed(0);
                                break;
                            case 1:
                                slowFlashLed(3); // Yellow
                                break;
                            case 2:
                                slowFlashLed(1);
                                break;
                            default:
                                break;
                        }
                        break;

                    case 2: 
                        // Hold -> change system's status
                        slowFlashLed(3);
                        system_status();
                        break;

                    case 3: 
                        // Long hold -> send registration request
                        slowFlashLed(2);
                        slowFlashLed(2);
                        slowFlashLed(2);
                        request_registration();
                        break;

                    default:
                       break;
                }
            }
        }
        

        // Alert pending
        if (alert_pending() && !get_http_request_executing())
        {
            if (!get_gps_searching()) {
                
                set_alert_pending(false);
                trigger_alert();

                // Check if user wants location data after alert
                if (get_location_on_alert()) {
                    set_search_gps_location(true);
                }

            }
        }


        // Get location from GPS pending
        if (get_search_gps_location() && !get_http_request_executing()) {

            if (!get_gps_searching()) {
                // If GPS is not reserved already and location on alert is true

                err = gps_start(gps_dev, &conf);
            
                if (err) {
                    printk("Err with gps_start \n");
                } else {
                    // On success, reserve GPS
                    set_search_gps_location(false);
                    set_gps_searching(true);
                }

            }
        }

        if (get_send_gps_location() && !get_http_request_executing()) {
            set_send_gps_location(false);
            send_location();


        }

        
        // Sensor data sending pending        
        if ((k_uptime_get() - get_sensor_data_last_sent()) > ( get_connection_interval() * 1000 )) 
        {
            if (!first_time) 
            {
                // Set new timestamp in anycase - sensor data not so important that missing packets are allowed
                set_sensor_data_last_sent(k_uptime_get());

                // Don't send sensor data if GPS is searching
                if (!get_gps_searching()) {

                    if (!get_http_request_executing()) {
                        send_sensor();
                    }
                }
                

            } else {
                // Don't send sensor data if device just got started
                set_sensor_data_last_sent(k_uptime_get());
                first_time = false;
            }
        }

        
        k_msleep(500);
    }
    
}
```

## src/at_cmd.c
```c
#include <string.h>
#include <zephyr.h>
#include <stdlib.h>
#include <stdio.h>
#include <modem/at_cmd.h>
#include <net/socket.h>
#include <nrf_errno.h>
#include <modem/at_notif.h>
#include "at_cmd.h"

#define SPACE 0
#define QUOTE 1

// LOG_MODULE_REGISTER(main, LOG_LEVEL_DBG);    // For logging

static char device_imei[50];
static char device_battery_charge[15]; // orig 15


char* get_imei(void) {
    return device_imei;
}

void init_mag(void) {

    int err;

    err = at_cmd_write(
        "AT%XMAGPIO=1,1,1,7,1,746,803,2,698,748,2,1710,2200,3,824,894,4,880,960,5,791,849,7,1574,1577", NULL, 0, NULL
    );

    if (err) {
        printk("Failed to set MAGPIO, err %d\n", err);
    }

}


// Get values from modem without prefix
void at_substring(char *char_array, int char_array_size, int separator) {
    
    char *p;
    char *sep;
    int offset;
    
    if (separator == 1) {
        sep = "\"";
        offset = 15;
    } else {
        sep = " ";
        offset = 4;
    }
   
    p = strstr(char_array, sep);
    if (p != NULL) {
        strcpy(char_array, p + 1);
        char_array[offset] = '\0';
    } else {
        printk("Couldn't parse values out of modem's buffer\n");
        return;
    }
}

void at_error_handler(int err_code, char *command) {
    if (err_code == 0) {
        printk("AT command executed succesfully for %s\n", command);
    } else {
        printk("AT command execution failed when exec. command %s\n", command);
    }
}

// Get device's IMEI from modem using +CGSN
void get_device_imei(void)
{
    int buffer_size = 50;
    char rec_buf[50];
    char e_command[10] = "AT+CGSN=1"; // IMEI
	enum at_cmd_state state;

	int ret = at_cmd_write(e_command, rec_buf, buffer_size, &state);
    at_error_handler(ret, e_command);
    at_substring(rec_buf, 50, QUOTE);
    rec_buf[strlen(rec_buf)] = '\0';
    strcpy(device_imei, rec_buf);
}

// Get device's battery voltage from modem using %XVBAT
char* get_device_battery_charge(void)
{
    int buffer_size = 15;
	char e_command[9] = "AT%XVBAT"; // BATT
	enum at_cmd_state state;
	int ret = at_cmd_write(e_command, device_battery_charge, buffer_size, &state);
    
    at_error_handler(ret, e_command);
    at_substring(device_battery_charge, 15, SPACE);
    return device_battery_charge;
}

// Get battery charge as integer
int get_battery_charge(void) 
{
    char *battery_charge;
    int battery_charge_int;
    
    battery_charge = get_device_battery_charge();
    battery_charge_int = atoi(battery_charge);

    return battery_charge_int;
}

int get_battery_level(void)
{

    int charge;
    int limit_values[2] = {3483, 3966};
    charge = get_battery_charge();
    for (int x = 0; x < (sizeof(limit_values) / sizeof(limit_values[0])); x++)
    {
        if (charge < limit_values[x]) { return x; }
    }
    // There weren't value less that charge, its max value then
    return (sizeof(limit_values) / sizeof(limit_values[0]));
}
```

## src/at_cmd.h
```c
#include <string.h>
#include <zephyr.h>
#include <stdlib.h>
#include <stdio.h>
#include <modem/at_cmd.h>
#include <net/socket.h>
#include <nrf_errno.h>
#include <modem/at_notif.h>

char* get_imei(void);
void init_mag(void);
void at_substring(char*, int, int);
void at_error_handler(int, char*);
void get_device_imei(void);
char* get_device_battery_charge(void);
int get_battery_charge(void);
int get_battery_level(void);
void get_traces(void);
```

## src/btn_handler.c
```c
#include <zephyr.h>
#include <device.h>
#include <drivers/gpio.h>
#include <sys/util.h>
#include <inttypes.h>
#include "btn_handler.h"

// Times for button up and down
static s64_t start_time = 0;
static s64_t end_time = 0;

static bool btn_act_pending = 0;

bool get_btn_act_pending(void)
{
	return btn_act_pending;
}

void set_btn_act_pending(bool new_value)
{
	btn_act_pending = new_value;
}

void setBtnDownTime(void) 
{
    printk("- DOWN - \n");
    start_time = k_uptime_get();
}

void setBtnUpTime() 
{
    printk("- UP - \n");
    end_time = k_uptime_get();
}

int calcBtnTime() 
{
    int action;
    s64_t hold_time = (end_time - start_time);

    // Which action must be executed
    if (hold_time >= 7000){
        action = 3;
    } else if (hold_time >= 2000 && hold_time < 5500) {
        action = 2;
    } else if (hold_time > 300 && hold_time < 1500) {
        action = 1;
    } else { action = 0; }
    
    return action;    
}
```

## src/btn_handler.h
```c
#include <zephyr.h>
#include <device.h>
#include <drivers/gpio.h>
#include <sys/util.h>
#include <inttypes.h>

bool get_btn_act_pending(void);
void set_btn_act_pending(bool);

void setBtnDownTime(void);
void setBtnUpTime(void);
int calcBtnTime(void);
```

## src/http_request - Copy - Copy.c
```c
/*
 * Copyright (c) 2020 Nordic Semiconductor ASA
 *
 * SPDX-License-Identifier: LicenseRef-BSD-5-Clause-Nordic
 */

 // TODO at_notif: Already initialized. Nothing to do


#include <string.h>
#include <zephyr.h>
#include <stdlib.h>
#include <net/socket.h>
#include <modem/bsdlib.h>
#include <net/tls_credentials.h>
#include <modem/lte_lc.h>
#include <modem/at_cmd.h>
#include <modem/at_notif.h>
#include <modem/modem_key_mgmt.h>

#include <math.h>
#include <stdint.h>
#include <stdio.h>

#include "led.h"


#include "http_request.h"

#define HTTPS_PORT 443

#define HTTP_HEAD                                       \
	"GET HTTP/1.1\r\n"   \
	"Host: watchdog.rantakangas.com:443\r\n"                  \
	"Connection: close\r\n\r\n"



#define HTTP_HEAD_LEN (sizeof(final_send_buf) - 1)




#define HTTP_HDR_END "\r\n\r\n"

#define RECV_BUF_SIZE 2048
#define TLS_SEC_TAG 42

static const char send_buf[] = HTTP_HEAD;
static char recv_buf[RECV_BUF_SIZE];

/* Certificate for `*.rantakangas.com` */
static const char cert[] = {
	#include "../cert/GlobalSign-Root-CA-R2"
};

BUILD_ASSERT(sizeof(cert) < KB(4), "Certificate too large");

int get_recv_buf_size(void)
{
    return RECV_BUF_SIZE;
}

/* Initialize AT communications */
int at_comms_init(void)
{
	int err;

	err = at_cmd_init();
	if (err) {
		printk("Failed to initialize AT commands, err %d\n", err);
		return err;
	}

	err = at_notif_init();
	if (err) {
		printk("Failed to initialize AT notifications, err %d\n", err);
		return err;
	}

	return 0;
}

/* Provision certificate to modem */
int cert_provision(void)
{
	int err;
	bool exists;
	u8_t unused;

	err = modem_key_mgmt_exists(TLS_SEC_TAG,
				    MODEM_KEY_MGMT_CRED_TYPE_CA_CHAIN,
				    &exists, &unused);
	if (err) {
		printk("Failed to check for certificates err %d\n", err);
		return err;
	}

	if (exists) {
		/* For the sake of simplicity we delete what is provisioned
		 * with our security tag and reprovision our certificate.
		 */
		err = modem_key_mgmt_delete(TLS_SEC_TAG,
					    MODEM_KEY_MGMT_CRED_TYPE_CA_CHAIN);
		if (err) {
			printk("Failed to delete existing certificate, err %d\n",
			       err);
		}
	}

	printk("Provisioning certificate\n");

	/*  Provision certificate to the modem */
	err = modem_key_mgmt_write(TLS_SEC_TAG,
				   MODEM_KEY_MGMT_CRED_TYPE_CA_CHAIN,
				   cert, sizeof(cert) - 1);
	if (err) {
		printk("Failed to provision certificate, err %d\n", err);
		return err;
	}

	return 0;
}

/* Setup TLS options on a given socket */
int tls_setup(int fd)
{
	int err;
	int verify;

	/* Security tag that we have provisioned the certificate with */
	const sec_tag_t tls_sec_tag[] = {
		TLS_SEC_TAG,
	};

	/* Set up TLS peer verification */
	enum {
		NONE = 0,
		OPTIONAL = 1,
		REQUIRED = 2,
	};

	verify = REQUIRED;

	err = setsockopt(fd, SOL_TLS, TLS_PEER_VERIFY, &verify, sizeof(verify));
	if (err) {
		printk("Failed to setup peer verification, err %d\n", errno);
		return err;
	}

	/* Associate the socket with the security tag
	 * we have provisioned the certificate with.
	 */
	err = setsockopt(fd, SOL_TLS, TLS_SEC_TAG_LIST, tls_sec_tag,
			 sizeof(tls_sec_tag));
	if (err) {
		printk("Failed to setup TLS sec tag, err %d\n", errno);
		return err;
	}

	return 0;
}

int init_http_request() {
    int err;
    err = bsdlib_init();
	if (err) {
		printk("Failed to initialize bsdlib! Or bsdlib already initialized! \n");
		return err;
	}
}

void create_payload(char *final_send_buf, char *get_url, int get_url_size) {
    
    int y = 0;

    
    
    // "GET_"
    for (int x = 0; x < 4; x++) {
        final_send_buf[x] = send_buf[x];
        y++;
    }

    // payload
    //for (int x = 0; x < sizeof(get_url) - 1; x++) {
    for (int x = 0; x < get_url_size - 1; x++) {
        final_send_buf[y] = get_url[x];
        //printk("x: %d , y: %d , c: %c \n", x, y, get_url[x]);
        y++;
    }
    
    // Add space between get url and host...
    final_send_buf[y] = ' ';
    y++;

    // Rest of http
    for (int x = 0; x < sizeof(send_buf) -1 -4; x++) {
        //printk("%d, %c \n", x, send_buf[x + 4]);
        final_send_buf[y] = send_buf[x + 4];
        y++;
    }

    // Last character!
    final_send_buf[y] = '\0';

}

/*void toArray(int number, char *numberArray)
{
    int n = log10(number) + 1;
    int i;
    //char numberArray = calloc(n, sizeof(char));
    for ( i = 0; i < n; ++i, number /= 10 )
    {
        numberArray[i] = number % 10;
    }
    //return numberArray;
}*/

char* send_request(char *req_response_buf, int req_type, char *device_imei, int device_imei_size, int temp_int, int hum_int, int air_q_int, char *battery_charge) {

    
    
    // Calculate how many numbers int contains
    int temp_n_digits = log10(abs(temp_int)) + 2; // Also \0
    int hum_n_digits = log10(abs(hum_int)) + 2;

    printk("Hum digits count : %d \n", hum_n_digits -1 );

    // If int was negative, add one place to negative-mark
    if (temp_int < 0) temp_n_digits++; 
    if (hum_int < 0) hum_n_digits++;

    // Arrays for values like temp, hum, batt
    char temperature[temp_n_digits];
    char humidity[hum_n_digits + 1]; // +1 for slash before value
    
    // Ints to char arrays
    sprintf(temperature, "%d\0", temp_int); // Note slashes before values!
    sprintf(humidity, "/%d\0", hum_int); 

    
    
    // The final payload will be saved here
    char final_send_buf[150];
        
    // Get url
    char get_url[100] = ""; // orig 50
    
    // Requset (get_url) lenght
    int req_size = 0;

    switch (req_type) {
        case 0:
            
            //SENSOR_DATA
            printk("Asked to create payload for sensor data... \n");

            // Static pieces from request
            char prefix[] = "/api/v1/";
            char cenfix[] = "/send/sensor/";

            // Fake humidity, air_uality and battery charge
            char suffix[] = "/-1/";

            // Convert temperature (int) to the char array 
            
            sprintf(temperature, "%d", temp_int);

            printk("viela ok \n");

            // Make paylaod from char arrays
            strcat(get_url, prefix);
            strcat(get_url, device_imei);
            strcat(get_url, cenfix);
            strcat(get_url, temperature);
            strcat(get_url, humidity);
            strcat(get_url, suffix); // (air_q)
            strcat(get_url, battery_charge);

            // Calculate get req size
            //printk("prefix size %d \n", sizeof(prefix));
            //printk("device_imei  size %d \n", device_imei_size);
            //printk("cenfix size %d \n", sizeof(cenfix));
            //printk("temp size %d \n", sizeof(temperature));
            printk("battery_charge size %d \n", sizeof(battery_charge));
            
            req_size = sizeof(prefix) + device_imei_size + sizeof(cenfix) + sizeof(temperature) + sizeof(humidity) + sizeof(suffix) - 5 + sizeof(battery_charge); // -5 bc each sizeof is 1 too large

            //printk("temp char array sisalto %s \n", temperature);
            //printk("temp char array sisalto %d \n", temp_int);


            break;

        case 1:
            //REGISTRATION_DATA
            printk("Asked to create payload for registration data... \n");

            char rr_prefix[] = "/api/v1/";
            char rr_suffix[] = "/request/registration/";

            // Make paylaod from char arrays
            strcat(get_url, rr_prefix);
            strcat(get_url, device_imei);
            strcat(get_url, rr_suffix);

            req_size = sizeof(rr_prefix) + device_imei_size + sizeof(rr_suffix) - 2;

            break;

        case 2:
            //ALERT_DATA
            printk("Asked to create payload for alert data... \n");

            char ta_prefix[] = "/api/v1/";
            char ta_suffix[] = "/trigger/alert/accel";

            // Make paylaod from char arrays
            strcat(get_url, ta_prefix);
            strcat(get_url, device_imei);
            strcat(get_url, ta_suffix);

            req_size = sizeof(ta_prefix) + device_imei_size + sizeof(ta_suffix) - 2;

            break;

        case 3:
            //change system_status
            printk("Asked to create payload system status data... \n");

            char ss_prefix[] = "/api/v1/";
            char ss_true[] = "/systemStatus/true";
            char ss_false[] = "/systemStatus/false";

            // Make paylaod from char arrays
            strcat(get_url, ss_prefix);
            strcat(get_url, device_imei);

            if (get_system_armed())
            {
                strcat(get_url, ss_false);
                req_size = sizeof(ss_prefix) + device_imei_size + sizeof(ss_false) - 2;
            } else {
                strcat(get_url, ss_true);
                req_size = sizeof(ss_prefix) + device_imei_size + sizeof(ss_true) - 2;
            }
            
            

            break;



        default:
            printk("User didn't specify which data will be sent to the server \n");
            return;          

    }

    
    printk("final_send_buffer:  '%s'\n", final_send_buf);
    printk("get_url:            '%s'\n", get_url);
    printk("get_url:n pituus:   '%d'\n", req_size);
    
    
    create_payload(final_send_buf, get_url, req_size);

    printk("_______________________\n'%s'", final_send_buf);
    printk("_______________________\n\n");
    
    //return;
    //goto clean_up;



    
  
	int err;
	int fd;
	char *p;
	int bytes;
	size_t off;
	struct addrinfo *res;
	struct addrinfo hints = {
		.ai_family = AF_INET,
		.ai_socktype = SOCK_STREAM,
	};

	printk("HTTPS client sample started\n\r");

	/* Initialize AT comms in order to provision the certificate */
	err = at_comms_init();
	if (err) {
		//return;
	}

    err = at_cmd_write("AT%XMAGPIO=1,1,1,7,1,746,803,2,698,748,2,1710,2200,3,824,894,4,880,960,5,791,849,7,1574,1577", NULL, 0, NULL);
    if (err) {
        printk("Failed to set MAGPIO, err %d\n", err);
        return err;
    }

	/* Provision certificates before connecting to the LTE network */
	err = cert_provision();
	if (err) {
		printk("CERT PROVISION FAILED");
		//return;
	}

	printk("Waiting for network.. ");
	err = lte_lc_init_and_connect();
	if (err) {
		printk("Failed to connect to the LTE network, err %d\n", err);
		//return;
	}
	printk("OK\n");

	err = getaddrinfo("watchdog.rantakangas.com", NULL, &hints, &res);
	if (err) {
		printk("getaddrinfo() failed, err %d\n", errno);
		//return;
	}

	((struct sockaddr_in *)res->ai_addr)->sin_port = htons(HTTPS_PORT);

	fd = socket(AF_INET, SOCK_STREAM, IPPROTO_TLS_1_2);
	if (fd == -1) {
		printk("Failed to open socket!\n");
		goto clean_up;
	}

	/* Setup TLS socket options */
	err = tls_setup(fd);
	if (err) {
		goto clean_up;
	}


	printk("Connecting to %s\n", "WATCHDOG.RANTAKANGAS.COM");
	
	err = connect(fd, res->ai_addr, sizeof(struct sockaddr_in));
	if (err) {
		printk("connect() failed, err: %d\n", errno);
		goto clean_up;
	}

	off = 0;
	do {
		//bytes = send(fd, &send_buf[off], HTTP_HEAD_LEN - off, 0);
        bytes = send(fd, &final_send_buf[off], HTTP_HEAD_LEN - off, 0);
		if (bytes < 0) {
			printk("send() failed, err %d\n", errno);
			goto clean_up;
		}
		off += bytes;
	} while (off < HTTP_HEAD_LEN);

	printk("Sent %d bytes\n", off);

	off = 0;
	do {
//		bytes = recv(fd, &recv_buf[off], RECV_BUF_SIZE - off, 0);
        bytes = recv(fd, &req_response_buf[off], RECV_BUF_SIZE - off, 0);

		if (bytes < 0) {
			printk("recv() failed, err %d\n", errno);
			goto clean_up;
		}
		off += bytes;
	} while (bytes != 0 /* peer closed connection */);

	printk("Received %d bytes\n", off);

	/* Print HTTP response */
	/*
    p = strstr(recv_buf, "\r\n");
	if (p) {
		off = p - recv_buf;
		recv_buf[off + 1] = '\0';
		printk("\n>\t %s\n\n", recv_buf);
	}*/



    printk("\n>\t %s\n\n", req_response_buf);


	printk("Finished, closing socket.\n");


clean_up:
	freeaddrinfo(res);
	(void)close(fd);

    return req_response_buf;

    /*

    printk("gethttpcontenttiin on menossa payload: '%s' \n", recv_buf);
    char recv_buf_content[RECV_BUF_SIZE];
    


    get_http_content(recv_buf, sizeof(recv_buf), recv_buf_content);

    // settings check success that checks if payload was received correctly on the server end
    //recv_buf = "{\"status\":\"Success\",\"wut\":\"Device\'s data saved to the Watchdog\'s database\"}";
    printk("kutsutaan check_status\n");
    printk("Sinne on menossa payloadina '%s' \n", recv_buf_content);
    printk("Sen pituus on '%d' \n", sizeof(recv_buf_content));

    return check_success(recv_buf_content);
    */
      
}
```

## src/http_request - Copy - Copy.h
```c
/*
 * Copyright (c) 2020 Nordic Semiconductor ASA
 *
 * SPDX-License-Identifier: LicenseRef-BSD-5-Clause-Nordic
 */

#include <string.h>
#include <zephyr.h>
#include <stdlib.h>
#include <net/socket.h>
#include <modem/bsdlib.h>
#include <net/tls_credentials.h>
#include <modem/lte_lc.h>
#include <modem/at_cmd.h>
#include <modem/at_notif.h>
#include <modem/modem_key_mgmt.h>


int get_recv_buf_size(void);

int at_comms_init(void);

/* Provision certificate to modem */

/* Setup TLS options on a given socket */
int tls_setup(int fd);

void create_payload(char *final_send_buf, char *get_url, int get_url_size);

char* send_request(char *, int type, char *device_imei, int device_imei_size, int temp_int, int hum_int, int air_q_int, char *battery_charge);

void toArray(int number, char* numberArray);
```

## src/http_request.c
```c
#include <string.h>
#include <zephyr.h>
#include <stdlib.h>
#include <net/socket.h>
#include <modem/bsdlib.h>
#include <net/tls_credentials.h>
#include <modem/lte_lc.h>
#include <modem/at_cmd.h>
#include <modem/at_notif.h>
#include <modem/modem_key_mgmt.h>
#include <math.h>
#include <stdint.h>
#include <stdio.h>
#include "http_request.h"
#include "payloads.h"
#include "led.h"


#define HTTPS_PORT 443
#define ADDR_MAX_LENGHT 100
#define HTTP_HEAD_LEN (sizeof(final_send_buf) - 1)
#define HTTP_HDR_END "\r\n\r\n"
#define RECV_BUF_SIZE 2048
#define TLS_SEC_TAG 42

static int fd;
static struct addrinfo *res;
static struct addrinfo hints = {
    .ai_family = AF_INET,
    .ai_socktype = SOCK_STREAM,
};

/* Certificate for `*.rantakangas.com` */
static const char cert[] = {
	#include "../cert/WD-Rantakangas"
};

BUILD_ASSERT(sizeof(cert) < KB(4), "Certificate too large");


int get_recv_buf_size(void) {
    return RECV_BUF_SIZE;
}

/* Initialize AT communications */
int at_comms_init(void)
{
	int err;

	err = at_cmd_init();
	if (err) {
		printk("Failed to initialize AT commands, err %d\n", err);
		return err;
	}

	err = at_notif_init();
	if (err) {
		printk("Failed to initialize AT notifications, err %d\n", err);
	}

	return 0;
}

/* Provision certificate to modem */
int cert_provision(void)
{
	int err;
	bool exists;
	u8_t unused;

	err = modem_key_mgmt_exists(TLS_SEC_TAG, MODEM_KEY_MGMT_CRED_TYPE_CA_CHAIN, &exists, &unused);
	if (err) {
		printk("Failed to check for certificates err %d\n", err);
		return err;
	}

	if (exists) {
		/* For the sake of simplicity we delete what is provisioned
		 * with our security tag and reprovision our certificate.
		 */
		err = modem_key_mgmt_delete(TLS_SEC_TAG, MODEM_KEY_MGMT_CRED_TYPE_CA_CHAIN);
		if (err) {
			printk("Failed to delete existing certificate, err %d\n", err);
		}
	}

	/*  Provision certificate to the modem */
	err = modem_key_mgmt_write(TLS_SEC_TAG,
				   MODEM_KEY_MGMT_CRED_TYPE_CA_CHAIN,
				   cert, sizeof(cert) - 1);
	if (err) {
		printk("Failed to provision certificate, err %d\n", err);
		return err;
	}

	return 0;
}

/* Setup TLS options on a given socket */
int tls_setup(int fd)
{
	int err;
	int verify;

	/* Security tag that we have provisioned the certificate with */
	const sec_tag_t tls_sec_tag[] = {
		TLS_SEC_TAG,
	};

	/* Set up TLS peer verification */
	enum {
		NONE = 0,
		OPTIONAL = 1,
		REQUIRED = 2,
	};

	verify = REQUIRED;

	err = setsockopt(fd, SOL_TLS, TLS_PEER_VERIFY, &verify, sizeof(verify));
	if (err) {
		printk("Failed to setup peer verification, err %d\n", errno);
		return err;
	}

	err = setsockopt(fd, SOL_TLS, TLS_SEC_TAG_LIST, tls_sec_tag, sizeof(tls_sec_tag));
	if (err) {
		printk("Failed to setup TLS sec tag, err %d\n", errno);
		return err;
	}

	return 0;
}

void get_server_ip(void) {

    char *p;
    char addr[ADDR_MAX_LENGHT];

    strcpy(addr, get_server_address());

    // Rip off srv address port number if there is 
    p = strstr(addr, ":");
    if (p) {
        *p = '\0';
    } 

	int err = getaddrinfo(addr, NULL, &hints, &res);
	if (err) {
		printk("getaddrinfo() failed, err %d. Trying to init http requests...\n", errno);
        init_http_request();
	}
    
    ((struct sockaddr_in *)res->ai_addr)->sin_port = htons(HTTPS_PORT);
}

int init_http_request() {
	

    int err;

    err = bsdlib_init();
	if (err) {
		printk("Failed to initialize bsdlib! Or bsdlib already initialized! Trying to continue\n");
	}

	err = at_comms_init();
	if (err) {
		return -1;
	}

    err = at_cmd_write("AT%XMAGPIO=1,1,1,7,1,746,803,2,698,748,2,1710,2200,3,824,894,4,880,960,5,791,849,7,1574,1577", NULL, 0, NULL);
    if (err) {
        printk("Failed to set MAGPIO, err %d\n", err);
        return -100;
    }

	/* Provision certificates before connecting to the LTE network */
	err = cert_provision();
	if (err) {
		printk("Cert provision failed");
		return -1;
	}


    
	printk("Waiting for network..\n");

	err = lte_lc_init_and_connect();
	if (err) {
        if (err == -120) {
            printk("Device has established connection already to network. \n");
        } else {
            printk("Failed to connect to the LTE network, err %d\n", err);
        }
	} else {
        printk("Connected to the network!\n");
    }
    
	
    

    get_server_ip();
    return 0;
}

void close_socket(void) {
	(void)close(fd);
}

// Send requst to the server
void send_request(char *req_response_buf, int req_type) {

    // Reserve request library
    set_http_request_executing(true);

    int err;
    int bytes;
    int req_size = 0;
    char final_send_buf[250] = "";
    char get_url[250] = "";


    /* Create endpoint address */
    switch (req_type) {
        case 0:
        {
            // SENSOR DATA
            sensor_payload(get_url, &req_size);   
            break;
        }
        case 1:
        {
            //REGISTRATION_DATA
            registration_payload(get_url, &req_size);
            break;
        }
        case 2:
        {
            //ALERT_DATA
            alert_payload(get_url, &req_size);            
            break;
        }
        case 3:
        {
            //CHANGE SYSTEM_STATUS
            status_payload(get_url, &req_size);
            break;

        }
        case 4:
        {
            //LOCATION DATA
            printf("@http_request: send_request (): LOCATION_DATA %f %f \n", get_latitude(), get_longitude());
            location_payload(get_url, &req_size);
            break;

        }

        default:
            printk("User didn't specify which data will be sent to the server \n");
            return;          

    }
    
    /* Create HTTP request and add previously created endpoint to it */
    create_payload(final_send_buf, get_url, req_size);
	
    // Open socket
	fd = socket(AF_INET, SOCK_STREAM, IPPROTO_TLS_1_2);
	if (fd == -1) {
		printk("Failed to open socket!\n");
        close_socket();
	}

    
	// Setup TLS socket options
	err = tls_setup(fd);
	if (err) {
        close_socket();
	}
    
    

	printk("Connecting to %s\n", get_server_address());
	
	err = connect(fd, res->ai_addr, sizeof(struct sockaddr_in));
	if (err) {
		printk("connect() failed, err: %d\n", errno);
        if (errno == 95) {
            printk("Connection was already established!\n");
            k_msleep(1000);
            
        } else {
            close_socket();
        }
	}

    printk("send\n");

    size_t off = 0;
	do {
        bytes = send(fd, &final_send_buf[off], HTTP_HEAD_LEN - off, 0);
		if (bytes < 0) {
			printk("send() failed, err %d\n", errno);
            close_socket();

		}
		off += bytes;
	} while (off < HTTP_HEAD_LEN);



    printk("receive\n");

	off = 0;
	do {
        bytes = recv(fd, &req_response_buf[off], RECV_BUF_SIZE - off, 0);

		if (bytes < 0) {
			printk("recv() failed, err %d\n", errno);
            if (errno == 9) {
                k_msleep(2000);
                close_socket();
                printk("Socket closed\n");
                return;
            }
            close_socket();
		}
		off += bytes;
	} while (bytes != 0 /* peer closed connection */);

    // Parsing message from response
    char *p;
    p = strstr(req_response_buf, HTTP_HDR_END);
	if (p) {
        strcpy(req_response_buf, (p + sizeof(HTTP_HDR_END) - 1));
	}

	printk("Finished, closing socket.\n");
    close_socket();

    // Release request library
    set_http_request_executing(false);
}
```

## src/http_request.h
```c
#include <string.h>
#include <zephyr.h>
#include <stdlib.h>
#include <net/socket.h>
#include <modem/bsdlib.h>
#include <net/tls_credentials.h>
#include <modem/lte_lc.h>
#include <modem/at_cmd.h>
#include <modem/at_notif.h>
#include <modem/modem_key_mgmt.h>
#include <zephyr.h>
#include "settings.h"


int get_recv_buf_size(void);

int at_comms_init(void);
int cert_provision(void);
int tls_setup(int fd);
void get_server_ip(void);
int init_http_request(void);
void close_socket(void);
void send_request(char *, int type);
```

## src/led.c
```c
#include <zephyr.h>
#include <device.h>
#include <devicetree.h>
#include <drivers/gpio.h>
#include "led.h"

#define LED0_NODE DT_ALIAS(led0) // R
#define LED1_NODE DT_ALIAS(led1) // G
#define LED2_NODE DT_ALIAS(led2) // B

#define LED_RED     DT_GPIO_LABEL(LED0_NODE, gpios)
#define LED_GREEN	DT_GPIO_LABEL(LED1_NODE, gpios)
#define LED_BLUE	DT_GPIO_LABEL(LED2_NODE, gpios)

#define PIN_RED     DT_GPIO_PIN(LED0_NODE, gpios)
#define PIN_GREEN	DT_GPIO_PIN(LED1_NODE, gpios)
#define PIN_BLUE	DT_GPIO_PIN(LED2_NODE, gpios)

#ifndef FLAGS
#define FLAGS	0
#endif

static struct device *led_dev;

void init_led(void) {

	int ret;
    
    // Binding device
	led_dev = device_get_binding(LED_RED);
	if (led_dev == NULL) {
        printk("Couldn't get device binding for LED0");
		return;
	}

    // Configure red
	ret = gpio_pin_configure(led_dev, PIN_RED, GPIO_OUTPUT_ACTIVE | FLAGS);
	if (ret < 0) {
        printk("Couldn't configure device LED0");
		return;
	}

    // Configure green
    ret = gpio_pin_configure(led_dev, PIN_GREEN, GPIO_OUTPUT_ACTIVE | FLAGS);
	if (ret < 0) {
        printk("Couldn't configure device LED1");
		return;
	}

    // Configure blue
    ret = gpio_pin_configure(led_dev, PIN_BLUE, GPIO_OUTPUT_ACTIVE | FLAGS);
	if (ret < 0) {
        printk("Couldn't configure device LED2");
		return;
	}

    // Sets all leds off on startup
    gpio_pin_set(led_dev, PIN_GREEN, 0);
    gpio_pin_set(led_dev, PIN_RED, 0);
    gpio_pin_set(led_dev, PIN_BLUE, 0);

}

// Set selected LED on or off 
void toggle_led(int color, int state) {
    switch (color)
    {
        case 0:
            gpio_pin_set(led_dev, PIN_RED, state);
            break;
        case 1:
            gpio_pin_set(led_dev, PIN_GREEN, state);
            break;
        case 2:
            gpio_pin_set(led_dev, PIN_BLUE, state);
            break;
        default:
            // On default turn all leds off
            gpio_pin_set(led_dev, PIN_RED, 0);
            gpio_pin_set(led_dev, PIN_GREEN, 0);
            gpio_pin_set(led_dev, PIN_BLUE, 0);
    }
}

void blink_led(int color, int steady_time) {
    int cycle_time = 300;
    // Rising light
    for (int x = 0; x < (cycle_time / 10); x++) {
        
        // If color is yellow or some other taht needs more than one led
        if (color >= 3) {
            // Yellow
            toggle_led(0, 1);
            toggle_led(1, 1);
        } else {
            // R, G or B
            toggle_led(color, 1);
        }
        
        if (x != 0 ) {
            k_msleep(x / 5);
        }

        if (color >= 3) {
            toggle_led(0, 0);
            toggle_led(1, 0);
        } else {
            toggle_led(color, 0);
        }
        
        k_msleep(((cycle_time / 10) - x) / 5);
    }

    // Steady on on middle
    if (color >= 3) {
        toggle_led(0, 1);
        toggle_led(1, 1);
    } else {
        toggle_led(color, 1);
    }
    
    
    k_msleep(steady_time);

    // Falling light
    for (int x = (cycle_time / 10); x > 0; x--) {
        
        toggle_led(color, 1);
        if (x != 0 ) {
            k_msleep(x / 5);
        }
        toggle_led(color, 0);
        k_msleep(((cycle_time / 10) - x) / 5);
    }

    // Wait a little bit on end of flash
    k_msleep(200);
}

// Fast flash
void flashLed(int color) {
    blink_led(color, 10);
}

// Slow flash
void slowFlashLed(int color) {
    blink_led(color, 500);
}
```

## src/led.h
```c
#include <zephyr.h>
#include <device.h>
#include <devicetree.h>
#include <drivers/gpio.h>

enum {
    RED,
    GREEN,
    BLUE
};

void init_led(void);
void toggle_led(int color, int state);
void blink_led(int color, int steady_time);
void flashLed(int color);
void slowFlashLed(int color);
```

## src/movement.c
```c
#include <zephyr.h>
#include <math.h>
#include <stdio.h>
#include <device.h>
#include <drivers/sensor.h>
#include "movement.h"
#include "led.h"
#include "settings.h"

#define abs (x) ((x) < 0 ? -(x) : (x))
#define UPPER_THRESH 150
#define LOWER_THRESH 1000

#define CALIB_TIMES 200
#define DEFAULT_MIN_VALUE -100
#define DEFAULT_MAX_VALUE 100

static struct sensor_value accel[3];
static struct device *accel_dev;
static struct calib_data c_data[CALIB_TIMES];
static struct calib_data accel_data; // For keskiarvo

static double avg_x, avg_y, avg_z = 0;

bool trigger_valid(void)
{
    /*
    // Returnable status, true if movement was correct
    double x_val, y_val, z_val = 1;
    sensor_sample_fetch(accel_dev);

    sensor_channel_get(accel_dev, SENSOR_CHAN_ACCEL_X, &accel[0]);
    sensor_channel_get(accel_dev, SENSOR_CHAN_ACCEL_Y, &accel[1]);
    sensor_channel_get(accel_dev, SENSOR_CHAN_ACCEL_Z, &accel[2]);

    x_val = fabs(sensor_value_to_double(&accel[0]));
    y_val = fabs(sensor_value_to_double(&accel[1]));
    z_val = fabs(sensor_value_to_double(&accel[2]));
   
    double errcor = 0.7;
    double z_errcor = 1.0;

    if (
        x_val > accel_data.x_max + errcor || 
            (x_val < accel_data.x_min - errcor && 
            accel_data.x_max != DEFAULT_MAX_VALUE)) 
    {
        return true;
    }

    if (y_val > accel_data.y_max + errcor || 
            (y_val < accel_data.y_min - errcor && 
            accel_data.x_max != DEFAULT_MAX_VALUE))
    {
        return true;
    }

    if (z_val > accel_data.z_max + z_errcor || 
            (z_val < accel_data.z_min - z_errcor && 
            accel_data.x_max != DEFAULT_MAX_VALUE))
    {
        return true;
    }

    return false;
    */
}

void calibrate_movement(void)
{
    printk("Calibrating...\n");

    k_msleep(1000);
    /*

    double x, y, z;
    double curr_x_max, curr_y_max, curr_z_max = 0;
    double curr_x_min, curr_y_min, curr_z_min = 0;

    // Get values to c_value array
    for (int i = 0; i < CALIB_TIMES; i++) 
    {
        
        sensor_sample_fetch(accel_dev);
        sensor_channel_get(accel_dev, SENSOR_CHAN_ACCEL_X, &accel[0]);
        sensor_channel_get(accel_dev, SENSOR_CHAN_ACCEL_Y, &accel[1]);
        sensor_channel_get(accel_dev, SENSOR_CHAN_ACCEL_Z, &accel[2]);

        x = fabs(sensor_value_to_double(&accel[0]));
        y = fabs(sensor_value_to_double(&accel[1]));
        z = fabs(sensor_value_to_double(&accel[2]));

        
        if (i == 0)
        {
            curr_x_max = x;
            curr_y_max = y;
            curr_z_max = z;
            
            curr_x_min = x;
            curr_y_min = y;
            curr_z_min = z;

        }
        

        c_data[i].x = x;
        c_data[i].y = y;
        c_data[i].z = z;

        if (x > curr_x_max) curr_x_max = x;
        if (y > curr_y_max) curr_y_max = y;
        if (z > curr_z_max) curr_z_max = z;

        if (x < curr_x_min) curr_x_min = x;
        if (y < curr_y_min) curr_y_min = y;
        if (z < curr_z_min) curr_z_min = z;

        if ((i % 10) == 0) {
            flashLed(0);    
        }

        k_msleep(50);
        
    }

    // Put max and mins to struct
    accel_data.x_max = curr_x_max;
    accel_data.y_max = curr_y_max;
    accel_data.z_max = curr_z_max;

    accel_data.x_min = curr_x_min;
    accel_data.y_min = curr_y_min;
    accel_data.z_min = curr_z_min;


    // Calculate average 

    for (int i = 0; i < CALIB_TIMES; i++) 
    {
        avg_x += c_data[i].x;
        avg_y += c_data[i].y;
        avg_z += c_data[i].z;
    }

    accel_data.x = avg_x / CALIB_TIMES;
    accel_data.y = avg_y / CALIB_TIMES;
    accel_data.z = avg_z / CALIB_TIMES;
    */
}

void trigger_handler(struct device *accel_dev, struct sensor_trigger *trig)
{
    printk("@trigger_handler\n");    
    /*  
    switch (trig->type) {
	case SENSOR_TRIG_THRESHOLD:
		printf("Threshold trigger\n");
        // Checks if alert should be triggered
        if (trigger_valid() && get_system_armed() && alert_interval_valid())
        {
            slowFlashLed(2);
            printk("ALERT TRIGGERED! \n");

            set_alert_pending(true);
            
        }  else {

            if (trigger_valid() && !get_system_armed() && alert_interval_valid()) {
                // Trigger was valid but system isn't armed
            }
        }
		break;
	default:
		printf("Unknown trigger\n");
	}
    */
}

void init_movement(void)
{
    /*
	accel_dev = device_get_binding(DT_LABEL(DT_INST(0, adi_adxl362)));
	if (accel_dev == NULL) {
		printf("Adxl362 binding failed\n");
		return;
	} else {
        printk("Adxl362 binded successfully\n");
    }

	if (IS_ENABLED(CONFIG_ADXL362_TRIGGER)) {
		struct sensor_trigger trig = { .chan = SENSOR_CHAN_ACCEL_XYZ };
		trig.type = SENSOR_TRIG_THRESHOLD;
		if (sensor_trigger_set(accel_dev, &trig, trigger_handler)) {
			printf("Trigger set error\n");
			return;
		} else {
			printk("Trigger set \n");
		}
	}
	
    struct sensor_value new_lower = {LOWER_THRESH, 0};
	struct sensor_value new_upper = {UPPER_THRESH, 0};
	
	int sas_status = sensor_attr_set(accel_dev, SENSOR_CHAN_ACCEL_X, SENSOR_ATTR_LOWER_THRESH, &new_lower);
	sas_status = sensor_attr_set(accel_dev, SENSOR_CHAN_ACCEL_X, SENSOR_ATTR_UPPER_THRESH, &new_upper);
    
    accel_data.x_max = DEFAULT_MAX_VALUE;
    accel_data.y_max = DEFAULT_MAX_VALUE;
    accel_data.z_max = DEFAULT_MAX_VALUE;
	
    accel_data.x_min = DEFAULT_MIN_VALUE;
    accel_data.y_min = DEFAULT_MIN_VALUE;
    accel_data.z_min = DEFAULT_MIN_VALUE;
    */
}
```
